## sdkconfig.defaults
```kconfig
# ESP32C3 BIOS Flasher Configuration

# Use USB-SERIAL-JTAG for console
CONFIG_ESP_CONSOLE_USB_SERIAL_JTAG=y
CONFIG_USJ_ENABLE_USB_SERIAL_JTAG=y
CONFIG_ESP_CONSOLE_UART=n

# SPI Configuration
CONFIG_SPI_MASTER_ENABLED=y
CONFIG_SPI_SLAVE_ENABLED=n

# Flash Size
CONFIG_ESPTOOLPY_FLASHSIZE_4MB=y

# Logging
CONFIG_LOG_DEFAULT_LEVEL_INFO=y

# FreeRTOS
CONFIG_FREERTOS_HZ=1000

# Disable unused features
CONFIG_BT_ENABLED=n
CONFIG_WIFI_ENABLED=n

# Heap
CONFIG_HEAP_POISONING_DISABLED=y
```
